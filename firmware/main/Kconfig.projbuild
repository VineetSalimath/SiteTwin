## firmware/main/Kconfig.projbuild
```kconfig
menu "SiteTwin firmware"

config SITETWIN_ZIGBEE_CHANNEL
    int "Zigbee primary channel"
    range 11 26
    default 13

config SITETWIN_GATEWAY_UART_TX_PIN
    int "Gateway-to-Wi-Fi UART TX GPIO"
    default 4

config SITETWIN_GATEWAY_UART_RX_PIN
    int "Wi-Fi-to-gateway UART RX GPIO"
    range 0 30
    default 5

config SITETWIN_GATEWAY_UART_BAUD_RATE
    int "Gateway-to-Wi-Fi UART baud rate"
    default 115200

menu "Final four-port PCB profile"

config SITETWIN_FINAL_PCB_PROFILE
    bool "Enable final PCB board-port support"
    default n
    help
        Compile-time gate for the H1/H2 four-port board layer. This does not
        enable dynamic module attach/detach, hot-swap interrupts, or GPIO19
        output control.

config SITETWIN_FINAL_PCB_PORT_COUNT
    int "Universal port count"
    range 4 4
    default 4
    depends on SITETWIN_FINAL_PCB_PROFILE

config SITETWIN_FINAL_PCB_ID_ADC_GPIO
    int "ID_ADC GPIO"
    range 0 30
    default 0
    depends on SITETWIN_FINAL_PCB_PROFILE

config SITETWIN_FINAL_PCB_ID_MUX_SEL0_GPIO
    int "U2 ID mux A/SEL0 GPIO"
    range 0 30
    default 1
    depends on SITETWIN_FINAL_PCB_PROFILE

config SITETWIN_FINAL_PCB_ID_MUX_SEL1_GPIO
    int "U2 ID mux B/SEL1 GPIO"
    range 0 30
    default 2
    depends on SITETWIN_FINAL_PCB_PROFILE

config SITETWIN_FINAL_PCB_DATA_COMMON_GPIO
    int "U4 DATA_COMMON GPIO"
    range 0 30
    default 3
    depends on SITETWIN_FINAL_PCB_PROFILE

config SITETWIN_FINAL_PCB_HOTSWAP_WAKE_1_GPIO
    int "Port 1 TS884 wake GPIO"
    range 0 30
    default 6
    depends on SITETWIN_FINAL_PCB_PROFILE

config SITETWIN_FINAL_PCB_HOTSWAP_WAKE_2_GPIO
    int "Port 2 TS884 wake GPIO"
    range 0 30
    default 7
    depends on SITETWIN_FINAL_PCB_PROFILE

config SITETWIN_FINAL_PCB_HOTSWAP_WAKE_3_GPIO
    int "Port 3 TS884 wake GPIO"
    range 0 30
    default 22
    depends on SITETWIN_FINAL_PCB_PROFILE

config SITETWIN_FINAL_PCB_HOTSWAP_WAKE_4_GPIO
    int "Port 4 TS884 wake GPIO"
    range 0 30
    default 23
    depends on SITETWIN_FINAL_PCB_PROFILE

choice SITETWIN_FINAL_PCB_HOTSWAP_WAKE_POLARITY
    prompt "TS884 wake active polarity"
    default SITETWIN_FINAL_PCB_HOTSWAP_WAKE_POLARITY_UNKNOWN
    depends on SITETWIN_FINAL_PCB_PROFILE

config SITETWIN_FINAL_PCB_HOTSWAP_WAKE_POLARITY_UNKNOWN
    bool "Unknown (do not enable wake handling)"

config SITETWIN_FINAL_PCB_HOTSWAP_WAKE_ACTIVE_LOW
    bool "Active low (requires bench verification)"

config SITETWIN_FINAL_PCB_HOTSWAP_WAKE_ACTIVE_HIGH
    bool "Active high (requires bench verification)"

endchoice

config SITETWIN_FINAL_PCB_I2C_SDA_GPIO
    int "Shared I2C SDA GPIO"
    range 0 30
    default 10
    depends on SITETWIN_FINAL_PCB_PROFILE

config SITETWIN_FINAL_PCB_I2C_SCL_GPIO
    int "Shared I2C SCL GPIO"
    range 0 30
    default 11
    depends on SITETWIN_FINAL_PCB_PROFILE

config SITETWIN_FINAL_PCB_ID_MOSFET_GATE_GPIO
    int "Switched precision ID pull-up gate GPIO"
    range 0 30
    default 18
    depends on SITETWIN_FINAL_PCB_PROFILE

config SITETWIN_FINAL_PCB_BUZZER_GPIO
    int "Feature-gated shared buzzer/LED GPIO"
    range 0 30
    default 19
    depends on SITETWIN_FINAL_PCB_PROFILE
    help
        Defines the schematic net only. H1/H2 never configures or drives it.

config SITETWIN_FINAL_PCB_SHARED_ALARM_OUTPUT_VERIFIED
    bool "Shared alarm output electrically verified"
    default n
    depends on SITETWIN_FINAL_PCB_PROFILE
    help
        Keep disabled until the complete Q2/R36/load evidence establishes
        active polarity, PWM envelope, current, and dissipation limits. H1/H2
        do not consume this flag or enable GPIO19.

config SITETWIN_FINAL_PCB_DATA_MUX_SEL0_GPIO
    int "U4 DATA mux A/SEL0 GPIO"
    range 0 30
    default 21
    depends on SITETWIN_FINAL_PCB_PROFILE

config SITETWIN_FINAL_PCB_DATA_MUX_SEL1_GPIO
    int "U4 DATA mux B/SEL1 GPIO"
    range 0 30
    default 20
    depends on SITETWIN_FINAL_PCB_PROFILE

config SITETWIN_FINAL_PCB_MUX_SETTLE_US
    int "Mux settling delay (microseconds)"
    range 1 100000
    default 2000
    depends on SITETWIN_FINAL_PCB_PROFILE

config SITETWIN_FINAL_PCB_ID_SETTLE_US
    int "Precision ID divider settling delay (microseconds)"
    range 1 100000
    default 2000
    depends on SITETWIN_FINAL_PCB_PROFILE

config SITETWIN_FINAL_PCB_ID_SAMPLE_COUNT
    int "ID ADC sample count (must be odd)"
    range 3 9
    default 5
    depends on SITETWIN_FINAL_PCB_PROFILE

config SITETWIN_FINAL_PCB_ADC_FALLBACK_FULL_SCALE_MV
    int "Uncalibrated ADC fallback full-scale millivolts"
    range 3000 3600
    default 3300
    depends on SITETWIN_FINAL_PCB_PROFILE
    help
        Diagnostic fallback only. Provisional ID bands are not final without
        assembled-PCB calibrated measurements.

config SITETWIN_FINAL_PCB_ADC_FALLBACK_RAW_MAX
    int "Uncalibrated ADC fallback maximum raw code"
    range 1023 65535
    default 4095
    depends on SITETWIN_FINAL_PCB_PROFILE

config SITETWIN_FINAL_PCB_I2C_CONTROLLER
    int "Shared I2C controller"
    range 0 1
    default 0
    depends on SITETWIN_FINAL_PCB_PROFILE

config SITETWIN_FINAL_PCB_I2C_CLOCK_HZ
    int "Shared I2C clock frequency"
    range 10000 1000000
    default 100000
    depends on SITETWIN_FINAL_PCB_PROFILE

config SITETWIN_FINAL_PCB_I2C_TIMEOUT_MS
    int "Shared I2C transaction timeout"
    range 10 5000
    default 100
    depends on SITETWIN_FINAL_PCB_PROFILE

config SITETWIN_FINAL_PCB_I2C_INTERNAL_PULLUPS
    bool "Enable ESP32-C6 internal shared I2C pull-ups"
    default n
    depends on SITETWIN_FINAL_PCB_PROFILE

config SITETWIN_FINAL_PCB_DATA_COMMON_INTERNAL_PULLUP
    bool "Enable ESP32-C6 internal DATA_COMMON pull-up"
    default n
    depends on SITETWIN_FINAL_PCB_PROFILE
    help
        Applies to the shared OneWire/digital line used by DS18B20, PIR, and
        REED modules through the DATA mux.

config SITETWIN_FINAL_PCB_STABLE_SCAN_COUNT
    int "Consecutive matching port scans required before attach/detach/fault"
    range 2 10
    default 2
    depends on SITETWIN_FINAL_PCB_PROFILE

config SITETWIN_FINAL_PCB_SCAN_INTERVAL_MS
    int "Port identification scan interval (milliseconds)"
    range 10 10000
    default 200
    depends on SITETWIN_FINAL_PCB_PROFILE
    help
        How often the telemetry task re-scans all four ports for
        insertion/removal/type changes. Independent of each attached
        sensor's own sample_interval_ms.

endmenu

config SITETWIN_SHT41_ENABLED
    bool "Enable the Environment Pod SHT41 runtime"
    default y

config SITETWIN_SCD41_ENABLED
    bool "Enable the Environment Pod SCD41 CO2 runtime"
    default y

config SITETWIN_SGP40_ENABLED
    bool "Enable the Environment Pod SGP40 VOC Index runtime"
    default y
    depends on SITETWIN_SHT41_ENABLED
    help
        SHT41 is the sole temperature/humidity authority. SGP40 is disabled if
        SHT41 is unavailable because uncompensated/fallback operation is not
        part of the I2 production profile.

config SITETWIN_SHT41_I2C_CONTROLLER
    int "SHT41 I2C controller"
    range 0 1
    default 0
    depends on SITETWIN_SHT41_ENABLED || SITETWIN_SCD41_ENABLED || SITETWIN_SGP40_ENABLED

config SITETWIN_SHT41_I2C_SDA_PIN
    int "SHT41 development wiring SDA GPIO"
    range 0 30
    default 6
    depends on SITETWIN_SHT41_ENABLED || SITETWIN_SCD41_ENABLED || SITETWIN_SGP40_ENABLED

config SITETWIN_SHT41_I2C_SCL_PIN
    int "SHT41 development wiring SCL GPIO"
    range 0 30
    default 7
    depends on SITETWIN_SHT41_ENABLED || SITETWIN_SCD41_ENABLED || SITETWIN_SGP40_ENABLED

config SITETWIN_SHT41_I2C_ADDRESS
    hex "SHT41 7-bit I2C address"
    range 0x08 0x77
    default 0x44
    depends on SITETWIN_SHT41_ENABLED

config SITETWIN_SHT41_I2C_CLOCK_HZ
    int "SHT41 I2C clock frequency"
    range 10000 1000000
    default 100000
    depends on SITETWIN_SHT41_ENABLED || SITETWIN_SCD41_ENABLED || SITETWIN_SGP40_ENABLED

config SITETWIN_SHT41_I2C_TIMEOUT_MS
    int "SHT41 I2C transaction timeout"
    range 10 5000
    default 100
    depends on SITETWIN_SHT41_ENABLED || SITETWIN_SCD41_ENABLED || SITETWIN_SGP40_ENABLED

config SITETWIN_SHT41_ENABLE_INTERNAL_PULLUPS
    bool "Enable ESP32-C6 internal I2C pull-ups"
    default n
    depends on SITETWIN_SHT41_ENABLED || SITETWIN_SCD41_ENABLED || SITETWIN_SGP40_ENABLED

config SITETWIN_SHT41_SAMPLE_INTERVAL_MS
    int "SHT41 physical sampling interval"
    range 250 3600000
    default 1000
    depends on SITETWIN_SHT41_ENABLED

config SITETWIN_SHT41_CACHE_VALIDITY_MS
    int "SHT41 shared-result cache validity"
    range 10 1000
    default 250
    depends on SITETWIN_SHT41_ENABLED

config SITETWIN_SCD41_I2C_ADDRESS
    hex "SCD41 7-bit I2C address"
    range 0x08 0x77
    default 0x62
    depends on SITETWIN_SCD41_ENABLED

choice SITETWIN_SCD41_MEASUREMENT_MODE
    prompt "SCD41 periodic measurement mode"
    default SITETWIN_SCD41_MODE_LOW_POWER_PERIODIC
    depends on SITETWIN_SCD41_ENABLED

config SITETWIN_SCD41_MODE_LOW_POWER_PERIODIC
    bool "Low-power periodic measurement"

config SITETWIN_SCD41_MODE_PERIODIC
    bool "Standard periodic measurement"

endchoice

config SITETWIN_SCD41_POLL_INTERVAL_MS
    int "SCD41 data-ready poll interval"
    range 250 30000
    default 1000
    depends on SITETWIN_SCD41_ENABLED

config SITETWIN_SGP40_I2C_ADDRESS
    hex "SGP40 7-bit I2C address"
    range 0x08 0x77
    default 0x59
    depends on SITETWIN_SGP40_ENABLED

choice SITETWIN_SGP40_ALGORITHM_INTERVAL
    prompt "SGP40 sampling and VOC algorithm interval"
    default SITETWIN_SGP40_ALGORITHM_INTERVAL_1S
    depends on SITETWIN_SGP40_ENABLED

config SITETWIN_SGP40_ALGORITHM_INTERVAL_1S
    bool "1 second"

config SITETWIN_SGP40_ALGORITHM_INTERVAL_10S
    bool "10 seconds"

endchoice

config SITETWIN_SGP40_COMPENSATION_MAXIMUM_AGE_MS
    int "Maximum age of SHT41 compensation data"
    range 250 30000
    default 2000
    depends on SITETWIN_SGP40_ENABLED

config SITETWIN_ENVIRONMENT_ALERT_LED_GPIO
    int "Environment Pod alert LED GPIO"
    range 0 30
    default 4
    help
        Real breadboard hardware: independently controllable GPIO, plain
        on/off. Not the same design as any single shared low-side branch
        described elsewhere for a future PCB revision -- see
        local_output.h.

config SITETWIN_ENVIRONMENT_ALERT_BUZZER_GPIO
    int "Environment Pod alert passive buzzer PWM GPIO"
    range 0 30
    default 5

config SITETWIN_ENVIRONMENT_ALERT_BUZZER_HZ
    int "Environment Pod alert buzzer PWM frequency (Hz)"
    range 100 10000
    default 2000
    help
        Starting point only, not yet tuned against the real buzzer's
        audible/comfortable range.

menu "Activity/Access Pod prototype wiring"

config SITETWIN_ACTIVITY_I2C_CONTROLLER
    int "Activity Pod I2C controller"
    range 0 1
    default 0

config SITETWIN_ACTIVITY_I2C_SDA_PIN
    int "Activity Pod I2C SDA GPIO"
    range 0 30
    default 6

config SITETWIN_ACTIVITY_I2C_SCL_PIN
    int "Activity Pod I2C SCL GPIO"
    range 0 30
    default 7

config SITETWIN_ACTIVITY_I2C_CLOCK_HZ
    int "Activity Pod I2C clock frequency"
    range 10000 1000000
    default 100000

config SITETWIN_ACTIVITY_I2C_TIMEOUT_MS
    int "Activity Pod I2C transaction timeout"
    range 10 5000
    default 100

config SITETWIN_ACTIVITY_I2C_INTERNAL_PULLUPS
    bool "Enable ESP32-C6 internal Activity Pod I2C pull-ups"
    default n

config SITETWIN_BH1750_I2C_ADDRESS
    hex "BH1750 7-bit I2C address"
    range 0x08 0x77
    default 0x23

config SITETWIN_BH1750_SAMPLE_INTERVAL_MS
    int "BH1750 physical sampling interval"
    range 250 3600000
    default 1000

config SITETWIN_ACTIVITY_PIR_GPIO
    int "SR505 PIR GPIO"
    range 0 30
    default 1

config SITETWIN_ACTIVITY_PIR_ACTIVE_HIGH
    bool "SR505 PIR output is active high"
    default y

config SITETWIN_ACTIVITY_PIR_STABILIZATION_MS
    int "PIR startup stabilization period"
    range 0 60000
    default 5000

config SITETWIN_ACTIVITY_PIR_RETRIGGER_MS
    int "PIR duplicate-event suppression period"
    range 0 60000
    default 1000

config SITETWIN_ACTIVITY_REED_GPIO
    int "Reed switch GPIO"
    range 0 30
    default 0

config SITETWIN_ACTIVITY_REED_OPEN_HIGH
    bool "Reed switch open state reads high"
    default y

config SITETWIN_ACTIVITY_REED_INTERNAL_PULLUP
    bool "Enable ESP32-C6 internal reed-switch pull-up"
    default y

config SITETWIN_ACTIVITY_REED_DEBOUNCE_MS
    int "Reed switch debounce interval"
    range 1 1000
    default 30

config SITETWIN_ACTIVITY_ALERT_LED_GPIO
    int "Activity Pod alert LED GPIO"
    range 0 30
    default 4
    help
        Real breadboard hardware: independently controllable GPIO, plain
        on/off. Not the same design as any single shared low-side branch
        described elsewhere for a future PCB revision -- see
        local_output.h.

config SITETWIN_ACTIVITY_ALERT_BUZZER_GPIO
    int "Activity Pod alert passive buzzer PWM GPIO"
    range 0 30
    default 5

config SITETWIN_ACTIVITY_ALERT_BUZZER_HZ
    int "Activity Pod alert buzzer PWM frequency (Hz)"
    range 100 10000
    default 2000
    help
        Starting point only, not yet tuned against the real buzzer's
        audible/comfortable range.

endmenu

menu "Equipment Pod prototype wiring"

config SITETWIN_EQUIPMENT_I2C_CONTROLLER
    int "Equipment Pod I2C controller"
    range 0 1
    default 0

config SITETWIN_EQUIPMENT_I2C_SDA_PIN
    int "Equipment Pod I2C SDA GPIO"
    range 0 30
    default 6

config SITETWIN_EQUIPMENT_I2C_SCL_PIN
    int "Equipment Pod I2C SCL GPIO"
    range 0 30
    default 7

config SITETWIN_EQUIPMENT_I2C_CLOCK_HZ
    int "Equipment Pod I2C clock frequency"
    range 10000 1000000
    default 100000

config SITETWIN_EQUIPMENT_I2C_TIMEOUT_MS
    int "Equipment Pod I2C transaction timeout"
    range 10 5000
    default 100

config SITETWIN_EQUIPMENT_I2C_INTERNAL_PULLUPS
    bool "Enable ESP32-C6 internal Equipment Pod I2C pull-ups"
    default n

config SITETWIN_INA219_I2C_ADDRESS
    hex "INA219 7-bit I2C address"
    range 0x08 0x77
    default 0x40

config SITETWIN_INA219_SHUNT_MILLIOHMS
    int "INA219 breakout shunt resistance (milliohms)"
    range 1 10000
    default 100

config SITETWIN_INA219_MAX_CURRENT_MA
    int "INA219 maximum expected current (mA)"
    range 1 32000
    default 3200

config SITETWIN_INA219_SAMPLE_INTERVAL_MS
    int "INA219 physical sampling interval"
    range 250 3600000
    default 1000

config SITETWIN_ADXL345_I2C_ADDRESS
    hex "ADXL345 7-bit I2C address"
    range 0x08 0x77
    default 0x53

config SITETWIN_ADXL345_SAMPLE_INTERVAL_MS
    int "ADXL345 RMS window interval"
    range 100 3600000
    default 5000

config SITETWIN_ADXL345_MINIMUM_WINDOW_SAMPLES
    int "ADXL345 minimum FIFO samples per RMS window"
    range 2 31
    default 16

config SITETWIN_DS18B20_GPIO
    int "Prototype Pod 3 DS18B20 1-Wire data GPIO"
    range 0 30
    default 0
    help
        This selects the verified fixed Pod 3 development wiring only. Type 5
        on the final universal board is DS18B20 with the 10 kohm ID code; its
        DATA path is selected through CD74HC4052M96 to DATA_COMMON on GPIO3.
        Universal-port discovery and mux selection remain feature-gated and
        are not enabled by this option.

config SITETWIN_DS18B20_INTERNAL_PULLUP
    bool "Enable ESP32-C6 internal DS18B20 pull-up"
    default y
    help
        This is only supplementary. Fit an external 4.7 kohm pull-up from
        DQ to 3.3 V for the fixed Pod 3 waterproof three-wire probe. This is
        not a final universal-board electrical specification.

config SITETWIN_DS18B20_RESOLUTION_BITS
    int "DS18B20 conversion resolution"
    range 9 12
    default 12

config SITETWIN_DS18B20_SAMPLE_INTERVAL_MS
    int "DS18B20 physical sampling interval"
    range 1000 3600000
    default 1000

config SITETWIN_EQUIPMENT_ALERT_LED_GPIO
    int "Equipment Pod alert LED GPIO"
    range 0 30
    default 4
    help
        Real breadboard hardware: independently controllable GPIO, plain
        on/off. Not the same design as any single shared low-side branch
        described elsewhere for a future PCB revision -- see
        local_output.h.

config SITETWIN_EQUIPMENT_ALERT_BUZZER_GPIO
    int "Equipment Pod alert passive buzzer PWM GPIO"
    range 0 30
    default 5

config SITETWIN_EQUIPMENT_ALERT_BUZZER_HZ
    int "Equipment Pod alert buzzer PWM frequency (Hz)"
    range 100 10000
    default 2000
    help
        Starting point only, not yet tuned against the real buzzer's
        audible/comfortable range.

endmenu

endmenu
```
